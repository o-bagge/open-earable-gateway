## build/ipc_radio/Kconfig/boards/Kconfig.defconfig
```kconfig
# Load Zephyr board defconfig descriptions.
osource "/opt/nordic/ncs/v3.0.1/zephyr/boards/nordic/nrf5340_audio_dk/Kconfig.defconfig"
```

## build/open-earable-gateway/Kconfig/boards/Kconfig.sysbuild
```kconfig
# Load Sysbuild board Kconfig descriptions.
osource "/opt/nordic/ncs/v3.0.1/zephyr/boards/nordic/nrf5340_audio_dk/Kconfig.sysbuild"
```
